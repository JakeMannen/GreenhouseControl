## src/main/Kconfig
```kconfig
menu "Greenhouse Controller Configuration"

    menu "Hardware Pins"
        config GH_SHT30_SDA_PIN
            int "SHT30 I2C SDA Pin"
            default 6
            help
                GPIO pin used for SHT30 SDA

        config GH_SHT30_SCL_PIN
            int "SHT30 I2C SCL Pin"
            default 7
            help
                GPIO pin used for SHT30 SCL

        config GH_VE_DIRECT_RX_PIN
            int "VE.Direct UART RX Pin"
            default 17
            help
                GPIO pin used to receive data from VE.Direct

        config GH_PUMP_GPIO_PIN
            int "Pump Relay GPIO Pin"
            default 20
            help
                GPIO pin used to control the pump relay

        config GH_BUTTON_GPIO_PIN
            int "Pump Manual Override Button Pin"
            default 21
            help
                GPIO pin for the manual override button to toggle the pump

        config GH_PAIRING_BUTTON_GPIO_PIN
            int "On-device Pairing Button Pin"
            default 9
            help
                GPIO pin for the on-device physical button used for pairing (usually BOOT button on GPIO 9)
    endmenu

    menu "Zigbee Settings"
        config GH_ZIGBEE_MANUFACTURER_NAME
            string "Manufacturer Name"
            default "Espressif"
            help
                Zigbee Manufacturer Name

        config GH_ZIGBEE_MODEL_IDENTIFIER
            string "Model Identifier"
            default "GreenHouse Controller"
            help
                Zigbee Model Identifier

        config GH_ZIGBEE_HW_VERSION
            int "Hardware Version"
            default 1
            help
                Zigbee Hardware Version

        config GH_ZIGBEE_APP_VERSION
            int "Application Version"
            default 1
            help
                Zigbee Application Version

        config GH_ZIGBEE_SW_BUILD_ID
            string "Software Build ID"
            default "0.0.1"
            help
                Zigbee Software Build ID
    endmenu

    menu "Misc Settings"
        config GH_PUMP_SAFETY_TIMEOUT_MIN
            int "Pump Safety Timeout (Minutes)"
            default 10
            help
                How many minutes before the pump automatically shuts off

        config GH_SHT30_POLL_INTERVAL_MS
            int "SHT30 Polling Interval (ms)"
            default 10000
            help
                How often to poll the SHT30 sensor in milliseconds

        config GH_BUTTON_DEBOUNCE_US
            int "Button Debounce (us)"
            default 250000
            help
                Button debounce time in microseconds

        config GH_LED_BLINK_BRIGHTNESS
            int "LED Blink Brightness (0-255)"
            default 85
            help
                Brightness of the status LED
    endmenu

    menu "DevKit LED Configuration"
        config GH_GPIO_LED_ON_DEVKIT
            int "LED GPIO on devkit"
            default 8 if IDF_TARGET_ESP32H2
            default 8 if IDF_TARGET_ESP32C6
            default 27 if IDF_TARGET_ESP32C5
            default 8
            help
                The GPIO connected to the LED on the devkits
    endmenu

endmenu
```

## src/sdkconfig.defaults
```kconfig
#
# Partition Table
#
CONFIG_PARTITION_TABLE_CUSTOM=y
CONFIG_PARTITION_TABLE_CUSTOM_FILENAME="partitions.csv"
# end of Partition Table

#
# Zigbee
#
CONFIG_ZB_ENABLED=y
# end of Zigbee

#
# Greenhouse Controller
#
CONFIG_GH_VE_DIRECT_INVERT_RX=y
```
